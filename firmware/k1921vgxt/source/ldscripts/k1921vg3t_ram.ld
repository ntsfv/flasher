/** @file
*  @brief linker script for K1921VG3T
*/

OUTPUT_ARCH( "riscv" )
ENTRY(_start)

MEMORY {
  ROM  (rwx) : ORIGIN = 0x00000000, LENGTH = 1M
  RAM  (rwx) : ORIGIN = 0x20000000, LENGTH = 256K
  TCM  (rwx) : ORIGIN = 0xF0000000, LENGTH = 64K
}

REGION_ALIAS("REGION_TEXT",   RAM );
REGION_ALIAS("REGION_RODATA", RAM);
REGION_ALIAS("REGION_DATA",   RAM);
REGION_ALIAS("REGION_BSS",    RAM);
REGION_ALIAS("REGION_STACK",  RAM);
REGION_ALIAS("REGION_TCM",    TCM );

STACK_SIZE = 2048;

INCLUDE "k1921vg3t_common.lds"
